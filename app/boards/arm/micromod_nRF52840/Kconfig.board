## app/boards/arm/micromod_nRF52840/Kconfig.board
```kconfig
config BOARD_MICROMOD_NRF52840
  bool "micromod_nrf52840"
  depends on SOC_NRF52840
```

## app/boards/arm/micromod_nRF52840/Kconfig.defconfig
```kconfig
if BOARD_MICROMOD_NRF52840

config BOARD
  default "micromod_nrf52840"

if USB_DEVICE_STACK

config USB_NRFX
  default y

endif # USB_DEVICE_STACK

config BT_CTLR
  default BT

config ZMK_BLE
  default y

config ZMK_USB
  default y

endif # BOARD_MICROMOD_NRF52840
```

## app/boards/arm/tyk380/Kconfig.board
```kconfig
# TyK380v2 board configuration
#
# Copyright (c) 2024 The ZMK Contributors
# SPDX-License-Identifier: MIT

config BOARD_TYK380_V2
    bool "TyK380v2 Keyboard based on Logitech K380s"
    depends on SOC_NRF52832_QFAB
```

## app/boards/arm/tyk380/Kconfig.defconfig
```kconfig
# Copyright (c) 2024 The ZMK Contributors
# SPDX-License-Identifier: MIT

if BOARD_TYK380_V2

config BOARD
    default "tyk380"

config ZMK_KEYBOARD_NAME
    default "TyK380v2"

config BT_CTLR
    default BT

endif # BOARD_TYK380_V2
```

## app/boards/arm/tyk380/tyk380_v2_defconfig
```kconfig
# SPDX-License-Identifier: MIT

CONFIG_SOC_SERIES_NRF52X=y
CONFIG_SOC_NRF52832_QFAB=y
CONFIG_BOARD_TYK380_V2=y

# enable MPU
CONFIG_ARM_MPU=n

# clock - we don't have an external one
CONFIG_CLOCK_CONTROL_NRF_K32SRC_RC=y
CONFIG_CLOCK_CONTROL_NRF_K32SRC_XTAL=n

# enable GPIO
CONFIG_GPIO=y
CONFIG_PINCTRL=y

## we use these pins for the keyboard
CONFIG_GPIO_AS_PINRESET=n
CONFIG_NFCT_PINS_AS_GPIOS=y

# enable settings
CONFIG_FLASH=y
CONFIG_FLASH_PAGE_LAYOUT=y
CONFIG_FLASH_MAP=y
CONFIG_NVS=y
CONFIG_SETTINGS=y
CONFIG_SETTINGS_NVS=y

# we need this to make sure that we don't overflow the
# usable flash area, as our available space is severely limited
CONFIG_USE_DT_CODE_PARTITION=y

# ZMK
## we don't have battery reporting (yet or maybe never)
CONFIG_ZMK_BATTERY_REPORTING=n
CONFIG_ZMK_EXT_POWER=n

## we only have ble
CONFIG_ZMK_USB=n
CONFIG_ZMK_BLE=y
CONFIG_BT_MAX_CONN=1
```
